#include "calidris.dtsi"

/* LEFT kscan override */
&kscan0 {
    row-gpios
		= <&gpio0 31 (GPIO_ACTIVE_HIGH | GPIO_PULL_DOWN)>
		, <&gpio0 30 (GPIO_ACTIVE_HIGH | GPIO_PULL_DOWN)>
		, <&gpio0 28 (GPIO_ACTIVE_HIGH | GPIO_PULL_DOWN)>
		, <&gpio0 4 (GPIO_ACTIVE_HIGH | GPIO_PULL_DOWN)>
		;

	col-gpios
		= <&gpio0 6 GPIO_ACTIVE_HIGH>
		, <&gpio0 7 GPIO_ACTIVE_HIGH>
		, <&gpio0 8 GPIO_ACTIVE_HIGH>
		, <&gpio0 5 GPIO_ACTIVE_HIGH>
		, <&gpio1 9 GPIO_ACTIVE_HIGH>
		;
};