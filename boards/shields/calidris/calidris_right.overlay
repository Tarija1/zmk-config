#include "calidris.dtsi" // The shared dtsi file is included in the overlay

// Label of the kscan node in the dtsi
&kscan0 {

&default_transform { // Offset of 5 because the left side has 5 columns
    col-offset = <5>;
};

    row-gpios
        = <&pro_micro 7 (GPIO_ACTIVE_HIGH | GPIO_PULL_DOWN)>
		, <&pro_micro 5 (GPIO_ACTIVE_HIGH | GPIO_PULL_DOWN)>
		, <&pro_micro 6 (GPIO_ACTIVE_HIGH | GPIO_PULL_DOWN)>
        , <&pro_micro 4 (GPIO_ACTIVE_HIGH | GPIO_PULL_DOWN)>
        ;
            
	col-gpios
			= <&pro_micro 19 GPIO_ACTIVE_HIGH>
			, <&pro_micro 20 GPIO_ACTIVE_HIGH>
			, <&pro_micro 21 GPIO_ACTIVE_HIGH>
			, <&pro_micro 22 GPIO_ACTIVE_HIGH>
			, <&pro_micro 18 GPIO_ACTIVE_HIGH>
;
    };
	
	

};