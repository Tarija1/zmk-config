## boards/shields/calidris/Kconfig.shield
```kconfig
# Copyright (c) 2020 Pete Johanson
# SPDX-License-Identifier: MIT

config SHIELD_CALIDRIS_LEFT
    def_bool $(shields_list_contains,calidris_left)

config SHIELD_CALIDRIS_RIGHT
    def_bool $(shields_list_contains,calidris_right)
corne
```

## boards/shields/calidris2/Kconfig.defconfig
```kconfig
if SHIELD_CALIDRIS_LEFT

# Name must be less than 16 characters long!
config ZMK_KEYBOARD_NAME
    default "calidris"

config ZMK_SPLIT_ROLE_CENTRAL
    default y

endif

if SHIELD_CALIDRIS_LEFT || SHIELD_CALIDRIS_RIGHT

config ZMK_SPLIT
    default y

endif
```
