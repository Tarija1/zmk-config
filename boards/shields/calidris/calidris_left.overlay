#include "calidris.dtsi"

&left {
    kscan {
        compatible = "zmk,kscan-gpio-matrix";

        diode-direction = "col2row";

        row-gpios
            = <&pro_micro 6 GPIO_ACTIVE_HIGH>
            , <&pro_micro 5 GPIO_ACTIVE_HIGH>
            , <&pro_micro 4 GPIO_ACTIVE_HIGH>
            , <&pro_micro 7 GPIO_ACTIVE_HIGH>;

        col-gpios
            = <&pro_micro 19 GPIO_ACTIVE_HIGH>
            , <&pro_micro 20 GPIO_ACTIVE_HIGH>
            , <&pro_micro 21 GPIO_ACTIVE_HIGH>
            , <&pro_micro 22 GPIO_ACTIVE_HIGH>
            , <&pro_micro 18 GPIO_ACTIVE_HIGH>;
    };

    connector: connector {
        compatible = "zmk,physical-layout-connector";
        #binding-cells = <0>;

        gpio-map = <
            0 0 &pro_micro 19
            0 1 &pro_micro 20
            0 2 &pro_micro 21
            0 3 &pro_micro 22
            0 4 &pro_micro 18

            1 0 &pro_micro 6
            1 1 &pro_micro 5
            1 2 &pro_micro 4
            1 3 &pro_micro 7
        >;
    };
};